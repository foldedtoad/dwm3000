/*
 * Copyright (c) 2021 Callender-Consulting, LLC
 *
 * SPDX-License-Identifier: Apache-2.0
 */

&arduino_spi {
    status = "okay";
    cs-gpios = <&arduino_header 16 GPIO_ACTIVE_LOW>; /* D10 */

    dwm3000@0 {
        compatible = "qorvo,dwm3000";
        label = "DWS3000";
        spi-max-frequency = <1000000>;
        reg = <0>;
        dwm-wakeup-gpios  = <&arduino_header 15 GPIO_ACTIVE_LOW>; /* D9 */
        dwm-irq-gpios     = <&arduino_header 14 GPIO_ACTIVE_LOW>; /* D8 */
        dwm-reset-gpios   = <&arduino_header 13 GPIO_ACTIVE_LOW>; /* D7 */
        dwm-rx-led-gpios  = <&arduino_header 10 GPIO_ACTIVE_LOW>; /* D4 */
        dwm-tx-led-gpios  = <&arduino_header  9 GPIO_ACTIVE_LOW>; /* D3 */
        dwm-spi-pol_gpios = <&arduino_header  7 GPIO_ACTIVE_LOW>; /* D1 */
        dwm-spi-pha_gpios = <&arduino_header  6 GPIO_ACTIVE_LOW>; /* D0 */
    };
};
